## CMakeLists.txt
```
# SPDX-License-Identifier: Apache-2.0

cmake_minimum_required(VERSION 3.20.0)

find_package(Zephyr REQUIRED HINTS $ENV{ZEPHYR_BASE})
project(_migraition3)

# set(CMAKE_BUILD_TYPE Debug)

target_include_directories(app PUBLIC /home/rlk/zephyrproject/zephyr/kernel/include)
target_include_directories(app PUBLIC /home/rlk/zephyrproject/zephyr/arch/x86/include)
# target_include_directories(app PUBLIC /home/rlk/zephyrproject/zephyr/arch/arm/include)

target_sources(app PRIVATE src/main.c)
target_sources(app PRIVATE src/utility.c)
```

## prj.conf
```kconfig
CONFIG_STDOUT_CONSOLE=y
# enable to use thread names
CONFIG_THREAD_NAME=y
CONFIG_NEWLIB_LIBC=y
CONFIG_THREAD_STACK_INFO=y

# Thread Analyzer
CONFIG_INIT_STACKS=y
CONFIG_THREAD_RUNTIME_STATS=y
CONFIG_SCHED_THREAD_USAGE=y
CONFIG_SCHED_THREAD_USAGE_ANALYSIS=y 

# Logging
CONFIG_NET_LOG=y
CONFIG_LOG=y
CONFIG_NET_STATISTICS=y
CONFIG_PRINTK=y

# Generic networking options
CONFIG_NETWORKING=y
CONFIG_NET_UDP=y
CONFIG_NET_TCP=y
CONFIG_NET_IPV4=n
CONFIG_NET_IPV6=y

# Schedule
CONFIG_TIMESLICING=y
CONFIG_TIMESLICE_SIZE=1000

# Kernel options
CONFIG_MAIN_STACK_SIZE=2048
CONFIG_ENTROPY_GENERATOR=y
CONFIG_TEST_RANDOM_GENERATOR=y
CONFIG_INIT_STACKS=y

# Socket
CONFIG_NET_SOCKETS=y
CONFIG_NET_SOCKETS_POSIX_NAMES=y
CONFIG_NET_SOCKETS_POLL_MAX=4
CONFIG_NET_CONNECTION_MANAGER=y

# IP address
CONFIG_NET_CONFIG_SETTINGS=y
CONFIG_NET_CONFIG_NEED_IPV4=n
CONFIG_NET_CONFIG_MY_IPV4_ADDR="192.0.2.1"
CONFIG_NET_CONFIG_PEER_IPV4_ADDR="192.0.2.2"
CONFIG_NET_CONFIG_NEED_IPV6=y
CONFIG_NET_CONFIG_MY_IPV6_ADDR="2001:db8::1"
CONFIG_NET_CONFIG_PEER_IPV6_ADDR="2001:db8::2"

# CONFIG_MACHINE_NO=0
# Debug
# CONFIG_DEBUG=y
CONFIG_DEBUG_COREDUMP=y
```

## src/main.c
```c
// #include <stdio.h>
// #include <string.h>
#include <zephyr/kernel.h>
#include <zephyr/sys/printk.h>
#include <zephyr/sys_clock.h>
// #include <zephyr/debug/thread_analyzer.h>
// #include <zephyr.h>
// #include <zephyr/net/socket.h>

// #include <zephyr/random/rand32.h>

/* size of stack area used by each thread */
#define STACKSIZE 1024

/* scheduling priority used by each thread */
#define PRIORITY 7

/* delay between greetings (in ms) */
#define SLEEPTIME 500


K_THREAD_STACK_DEFINE(threadA_stack_area, STACKSIZE);
static struct k_thread threadA_data;

K_THREAD_STACK_DEFINE(threadB_stack_area, STACKSIZE);
static struct k_thread threadB_data;


void threadA(void *dummy1, void *dummy2, void *dummy3)
{
	ARG_UNUSED(dummy1);
	ARG_UNUSED(dummy2);
	ARG_UNUSED(dummy3);

	int cnt=1;
	while(1){
		// printk("threadA =========, %d\n", cnt++);	

		thread_analyze_get(&threadB_data);

		k_busy_wait(100000);
		k_msleep(SLEEPTIME);
	}

}

void threadB(void *dummy1, void *dummy2, void *dummy3){
	ARG_UNUSED(dummy1);
	ARG_UNUSED(dummy2);
	ARG_UNUSED(dummy3);

	while(1){
		// printk("threadB =========\n");

		// thread_analyzer_run();
		// thread_analyzer_print();

		
		thread_analyze_get(&threadA_data);

		k_busy_wait(100000);
		k_msleep(SLEEPTIME);

	}

}

void main(void)
{

	k_thread_create(&threadA_data, threadA_stack_area,
			K_THREAD_STACK_SIZEOF(threadA_stack_area),
			threadA, NULL, NULL, NULL,
			PRIORITY, 0, K_FOREVER);
	k_thread_name_set(&threadA_data, "thread_a");

	k_thread_create(&threadB_data, threadB_stack_area,
			K_THREAD_STACK_SIZEOF(threadB_stack_area),
			threadB, NULL, NULL, NULL,
			PRIORITY, 0, K_FOREVER);
	k_thread_name_set(&threadB_data, "thread_b");

	k_thread_start(&threadA_data);
	k_thread_start(&threadB_data);

#ifdef __aarch64__
	printk("aarch64\n");
#endif 

}
```

## src/utility.c
```c
#include <zephyr/kernel.h>
#include <kernel_internal.h>
#include <zephyr/debug/thread_analyzer.h>
#include <zephyr/debug/stack.h>
#include <zephyr/kernel.h>
#include <zephyr/logging/log.h>
#include <stdio.h>

LOG_MODULE_REGISTER(thread_analyzer, CONFIG_THREAD_ANALYZER_LOG_LEVEL);

void thread_analyze_get(struct k_thread *cthread)
{
    // thread analyze
    k_thread_runtime_stats_t rt_stats_all;
    struct thread_analyzer_info info;

    struct k_thread *thread = (struct k_thread *)cthread;

    int ret;
    size_t size = thread->stack_info.size;
    char *name;

    size_t unused;
    int err;

    name = k_thread_name_get((k_tid_t)thread);

    err = k_thread_stack_space_get(thread, &unused);
    if (err) {
        LOG_WRN("%s: unable to get stack space (%d)", name, err);

        unused = 0;
    }

    info.name = name;
    info.stack_size = size;
    info.stack_used = size - unused;

    ret = 0;

    if (k_thread_runtime_stats_get(thread, &info.usage) != 0) {
        ret++;
    }

    if (k_thread_runtime_stats_all_get(&rt_stats_all) != 0) {
        ret++;
    }
    if (ret == 0) {
        info.utilization = (info.usage.execution_cycles * 100U) /
            rt_stats_all.execution_cycles;
    }

    size_t pcnt = (info.stack_used * 100U) / info.stack_size;

    printk("=========\n");
    printk("%s: STACK: unused %zu usage %zu / %zu (%zu %%); CPU: %u %%\n", info.name,
        info.stack_size - info.stack_used, info.stack_used, info.stack_size, pcnt, info.utilization);
    printk("=========\n");

    printk("execution_cycles: %llu; total_cycles: %llu; idle_cycles: %llu\n", info.usage.execution_cycles, 
        info.usage.total_cycles, info.usage.idle_cycles);

    printk("Current Frame: %llu; Longest Frame: %llu; Average Frame: %llu\n", info.usage.current_cycles, 
        info.usage.peak_cycles, info.usage.average_cycles);
}
```
